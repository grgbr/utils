## Config.in
```kconfig
config UTILS_PROVIDES_LIBS
       bool
       default n

config UTILS_ASSERT_API
	bool "API assertion"
	default n
	help
	  Build Utils library with high-level API assertions enabled to ensure
	  that API functions exposed by Utils will perform full verification of
	  arguments consistency.

config UTILS_ASSERT_INTERN
	bool "Internal assertion"
	select UTILS_ASSERT_API
	default n
	help
	  Build utils library with internal assertions enabled.

config ETUX_TRACE
	bool "Tracing support"
	default n
	help
	  Build utils library with LTTng tracing framework support.

config UTILS_UTEST
	bool "Unit tests"
	default n
	help
	  Build Utils library unit test suite.

config ETUX_PTEST
	bool "Performance tests"
	default n
	help
	  Build eTux library performance test suite.

config UTILS_ATOMIC
	bool "Atomic operations"
	default y
	help
	  Build utils library atomic operations framework.

config UTILS_SIGNAL
	bool "Signals"
	select UTILS_PROVIDES_LIBS
	default y
	help
	  Build utils library POSIX signal wrappers.

config UTILS_SIGNAL_FD
	bool "Signals file descriptor"
	select UTILS_SIGNAL
	select UTILS_FD
	default y
	help
	  Build utils library Linux signalfd wrappers.

config UTILS_THREAD
	bool "Threads"
	select UTILS_TIME
	default y
	help
	  Build utils library POSIX thread wrappers.

config UTILS_TIME
	bool "Time"
	select UTILS_PROVIDES_LIBS
	default y
	help
	  Build utils library POSIX clock and time wrappers.

menuconfig ETUX_TIMER
	bool "Timer"
	select UTILS_TIME
	default y
	help
	  Build eTux library with timer support.

if ETUX_TIMER

config ETUX_TIMER_SUBSEC_BITS
	int "Timer tick sub second precision bits"
	range 0 9
	depends on ETUX_TIMER
	default 6
	help
	  Setup timer tick period to 1000000000 >> ETUX_TIMER_TICK_SUBSEC_BITS
	  nanoseconds.
          The table below gives tick sub second precision according to allowed
          values:
              Bits     Tick period  Tick frequency
                    (milliseconds)         (Hertz)
                 0     1000.000000               1
                 1      500.000000               2
                 2      250.000000               4
                 3      125.000000               8
                 4       62.500000              16
                 5       31.250000              32
                 6       15.625000              64
                 7        7.812500             128
                 8        3.906250             256
                 9        1.953125             512

config ETUX_TIMER_LIST
	bool "Doubly linked timer list"
	depends on ETUX_TIMER
	default y
	help
	  Build eTux library with a simple ordered timer list algorithm
	  support.

config ETUX_TIMER_HEAP
	bool "Heap timer list"
	depends on ETUX_TIMER
	default y
	help
	  Build eTux library with a heap based timer algorithm support.

config ETUX_TIMER_HWHEEL
	bool "Hierarchical timer wheel"
	depends on ETUX_TIMER
	default y
	help
	  Build eTux library with hierarchical timer wheel algorithm support.

endif # ETUX_TIMER

config UTILS_PATH
	bool "Filesystem paths"
	default y
	select UTILS_PROVIDES_LIBS
	select UTILS_STR
	help
	  Build utils library POSIX filesystem paths manipulation utilities.

config UTILS_FD
	bool "File descriptors"
	select UTILS_PATH
	default y
	help
	  Build utils library POSIX file descriptor related wrappers.

config UTILS_PIPE
	bool "Pipe IPC"
	select UTILS_FD
	default y
	help
	  Build utils library POSIX IPC pipes support.

config UTILS_FILE
	bool "File"
	default y
	select UTILS_FD
	help
	  Build utils library POSIX filesystem file wrappers.

config UTILS_DIR
	bool "Directory"
	default y
	select UTILS_FD
	help
	  Build utils library POSIX filesystem directory wrappers.

config ETUX_FSTREE
	bool "Filesystem tree"
	default y
	select UTILS_DIR
	help
	  Build utils library with support for POSIX filesystem directory tree
	  iterator and scanner.

config UTILS_STR
	bool "String utilities"
	select UTILS_PROVIDES_LIBS
	default y
	help
	  Build utils library with string utilities support.

config UTILS_POLL
	bool "Polling"
	select UTILS_FD
	default y
	help
	  Build utils library with polling support.

menuconfig ETUX_NET
	bool "Network"
	default y
	help
	  Build eTux library with network support.

if ETUX_NET

config ETUX_NETDB
	bool "Network databases"
	select UTILS_PROVIDES_LIBS
	default y
	help
	  Build utils library with basic support for network databases.

config ETUX_NETIF
	bool "Network interface"
	select UTILS_PROVIDES_LIBS
	default y
	help
	  Build utils library with basic support for network interfaces.

config ETUX_SOCK
	bool
	select UTILS_FD
	default n

config UTILS_UNSK
	bool "UNIX sockets"
	select ETUX_SOCK
	default y
	help
	  Build utils library with UNIX socket support.

config UTILS_POLL_UNSK
	bool "Poll'able UNIX sockets"
	depends on UTILS_UNSK
	select UTILS_POLL
	default y
	help
	  Build utils library with poll'able UNIX socket support.

config ETUX_IN4SK
	bool "IPv4 sockets"
	select ETUX_SOCK
	select ETUX_NETDB
	default y
	help
	  Build utils library with IPv4 socket support.

config ETUX_IN6SK
	bool "IPv6 sockets"
	select ETUX_SOCK
	select ETUX_NETDB
	default y
	help
	  Build utils library with IPv6 socket support.

endif # ETUX_NET

config UTILS_MQUEUE
	bool "Message queue"
	select UTILS_PATH
	default y
	help
	  Build utils library with POSIX message queue support.

config UTILS_NET
	bool "Network object utilities"
	select UTILS_PATH
	default y
	help
	  Build utils library with network object related utilities support.

config UTILS_PWD
	bool "Password / group databases"
	select UTILS_STR
	default y
	help
	  Build utils library with support for browsing system password and
	  group databases.

# ex: ft=kconfig:
```
